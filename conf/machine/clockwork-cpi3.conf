## conf/machine/clockwork-cpi3.conf
```bitbake
#@TYPE: Machine
#@NAME: ClockworkPi 3
#@DESCRIPTION: Machine configuration for the ClockworkPi 3,
#              based on the Allwinner R16 CPU
#              https://www.clockworkpi.com/

require conf/machine/include/sun8i-nomali.inc

UBOOT_MACHINE = "clockworkpi_cpi3_defconfig"

KERNEL_DEVICETREE = "sun8i-r16-clockworkpi-cpi3.dtb"

IMAGE_CLASSES = "image_types"
IMAGE_FSTYPES = "squashfs-xz wic"
IMAGE_BOOT_FILES = "boot.scr ${KERNEL_IMAGETYPE} ${KERNEL_DEVICETREE}"

WKS_FILE = "sdimage-clockwork.wks"

PREFERRED_PROVIDER_virtual/kernel="linux-mainline"

MACHINE_EXTRA_RRECOMMENDS += "linux-firmware-bcm43430"

MACHINE_FEATURES += " wifi bluetooth"

PACKAGECONFIG_append_pn-libsdl2 = " kmsdrm"
```

## conf/machine/include/sun8i-nomali.inc
```bitbake
require conf/machine/include/sunxi.inc
#removed sunxi-mali.inc; upstream mesa supports mali via lima now
require conf/machine/include/tune-cortexa7.inc

SOC_FAMILY = "sun8i"
```

## wic/sdimage-clockwork.wks
```
part SPL   --source rawcopy --sourceparams="file=u-boot-sunxi-with-spl.bin" --ondisk mmcblk0 --no-table --align 8
part /boot --source bootimg-partition --ondisk mmcblk0 --fstype=vfat --label boot --active --fsoptions ro --fixed-size 8
part /     --source rootfs --ondisk mmcblk0 --fstype=squashfs --align 1
```
